## components/LCD_Driver/Kconfig.projbuild
```kconfig
menu "LCD Display Configuration"

    menu "SPI Bus"
        config LCD_SPI_HOST
            int "SPI Host (2=SPI2, 3=SPI3)"
            default 2
            range 2 3

        config LCD_PIN_SCK
            int "SPI SCK GPIO"
            default 12

        config LCD_PIN_MOSI
            int "SPI MOSI GPIO"
            default 11
    endmenu

    menu "LCD Control Pins"
        config LCD_PIN_CS
            int "LCD CS GPIO"
            default 10

        config LCD_PIN_DC
            int "LCD DC GPIO"
            default 5

        config LCD_PIN_RST
            int "LCD RST GPIO"
            default 4
    endmenu

    menu "LCD Parameters"
        config LCD_H_RES
            int "Horizontal resolution"
            default 240

        config LCD_V_RES
            int "Vertical resolution"
            default 320

        config LCD_SPI_CLOCK_HZ
            int "SPI clock frequency"
            default 40000000

        config LCD_SPI_CMD_BITS
            int "SPI command bits"
            default 8

        config LCD_SPI_PARAM_BITS
            int "SPI parameter bits"
            default 8
    endmenu

    menu "LVGL Task"
        config LVGL_TASK_PRIORITY
            int "LVGL task priority"
            default 4

        config LVGL_TASK_STACK_SIZE
            int "LVGL task stack size"
            default 8192

        config LVGL_TASK_CORE
            int "LVGL task core"
            default 1
            range 0 1

        config LVGL_TICK_PERIOD_MS
            int "LVGL tick period ms"
            default 2
    endmenu

endmenu
```

## main/Kconfig.projbuild
```kconfig
menu "User Configuration"

    menu "WiFi Configuration"

        config WIFI_SSID
            string "WiFi SSID"
            default "myssid"
            help
                SSID used by ConnectToWifi().

        config WIFI_PASSWORD
            string "WiFi Password"
            default "mypassword"
            help
                Password used by ConnectToWifi().

    endmenu

    config BROKER_URL
        string "Broker URL"
        default "mqtt://mqtt.eclipseprojects.io"
        help
            URL of the broker to connect to

    menu "MQTT Configuration"

        config MQTT_USERNAME
            string "MQTT Username"
            default ""
            help
                Username used by MQTT client authentication.

        config MQTT_PASSWORD
            string "MQTT Password"
            default ""
            help
                Password used by MQTT client authentication.

    endmenu

    menu "SNTP Configuration"

        config SNTP_TIMEZONE
            string "SNTP Timezone"
            default "CST-8"
            help
                POSIX timezone string used by setenv("TZ", ...).

        config SNTP_SERVER_0
            string "SNTP Server 0"
            default "ntp1.aliyun.com"
            help
                Primary SNTP server.

        config SNTP_SERVER_1
            string "SNTP Server 1"
            default "cn.pool.ntp.org"
            help
                Secondary SNTP server.

        config SNTP_MAX_RETRIES
            int "SNTP Max Retries"
            range 1 60
            default 15
            help
                Maximum retries while waiting SNTP synchronization.

        config SNTP_RETRY_DELAY_MS
            int "SNTP Retry Delay (ms)"
            range 100 10000
            default 2000
            help
                Delay between SNTP sync retries.

    endmenu

    config BROKER_URL_FROM_STDIN
        bool
        default y if BROKER_URL = "FROM_STDIN"

    menu "Pressure Sensor BLE"

        config PRESSURE_SENSOR1_BLE_ADDR
            string "Pressure Sensor 1 MAC"
            default ""
            help
                BLE MAC address of pressure sensor #1, format: AA:BB:CC:DD:EE:FF

        config PRESSURE_SENSOR2_BLE_ADDR
            string "Pressure Sensor 2 MAC"
            default ""
            help
                BLE MAC address of pressure sensor #2, format: AA:BB:CC:DD:EE:FF

        config PRESSURE_SENSOR_BLE_POLL_INTERVAL_MS
            int "Pressure Sensor Poll Interval (ms)"
            range 100 10000
            default 1000
            help
                Poll interval used by ESP32 to read pressure characteristic from connected BLE sensors.

    endmenu

endmenu
```

## sdkconfig.defaults
```kconfig
# LVGL Configuration
CONFIG_LV_COLOR_DEPTH_16=y
CONFIG_LV_MEM_CUSTOM=y
CONFIG_LV_USE_LOG=y
CONFIG_LV_LOG_LEVEL_WARN=y
CONFIG_LV_FONT_MONTSERRAT_14=y
CONFIG_LV_FONT_MONTSERRAT_18=y
CONFIG_LV_FONT_MONTSERRAT_20=y
CONFIG_LV_FONT_DEFAULT_MONTSERRAT_18=y
CONFIG_LV_USE_PERF_MONITOR=n
CONFIG_LV_USE_MEM_MONITOR=n
CONFIG_LV_USE_ASSERT_NULL=y
CONFIG_LV_USE_ASSERT_MALLOC=y
CONFIG_FATFS_LFN_HEAP=y
CONFIG_FATFS_MAX_LFN=255
CONFIG_WIFI_MGR_ENABLE_WEBUI=y
CONFIG_WIFI_MGR_WEBUI_CUSTOM_PATH="/littlefs"
CONFIG_LVGL_TASK_STACK_SIZE=4096
CONFIG_ESP_BUS_TASK_STACK_SIZE=3072
CONFIG_ESP_WIFI_STATIC_RX_BUFFER_NUM=6
CONFIG_ESP_WIFI_DYNAMIC_RX_BUFFER_NUM=16
CONFIG_ESP_WIFI_STATIC_TX_BUFFER_NUM=8
CONFIG_ESP_WIFI_CACHE_TX_BUFFER_NUM=16
CONFIG_ESP_WIFI_RX_BA_WIN=4
CONFIG_ESP_WIFI_TX_BA_WIN=4
```
